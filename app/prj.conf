## CMakeLists.txt
```
cmake_minimum_required(VERSION 3.20.0)

find_package(Zephyr REQUIRED HINTS $ENV{ZEPHYR_BASE})
project(app LANGUAGES C)

target_sources(app PRIVATE
    src/events_svc.c
    src/main.c
    src/user_interface.c
)
```

## Kconfig
```
#
# Copyright (c) 2024 Tareq Mhisen
#
# SPDX-License-Identifier: Apache-2.0
#

mainmenu "Environmental Sensor Application"

menu "Application configuration"

config MEASURING_PERIOD_SECONDS
    int "Sampling period for temperature and humidity measurements (in seconds)"
    default 60
    help
        Defines how frequently the sensor samples temperature and humidity data. Adjust this value to balance between data freshness and power consumption.

config FIRST_MEASUREMENT_DELAY_SECONDS
    int "Delay before the first measurement after device startup (in seconds)"
    default 10
    help
        Specifies the time to wait after booting before taking the initial measurement. This allows the device to stabilize before collecting data.

config NWK_ED_DEVICE_TIMEOUT_INDEX
    int "Index representing the end device timeout period"
    default 12
    help
        Corresponds to the timeout duration in minutes for the End Device Timeout Request command sent by an end device to inform its parent of its timeout requirements.
        For example, an index of 12 equals 4096 minutes. This setting allows the parent to remove the child from the neighbor table if it hasn't communicated within the specified time.

config KEEP_ALIVE_PERIOD_SECONDS
    int "Interval for sending keep-alive messages to the parent device (in seconds)"
    default 81920
    help
        Defines how often the end device sends keep-alive messages to its parent (e.g., a router or coordinator) to ensure it remains in the neighbor table.
        It's recommended to send approximately three keep-alive messages during the End Device Timeout period to maintain connectivity.

config LONG_POLL_PERIOD_SECONDS
    int "Interval at which a Sleepy End Device polls its parent for pending messages (in seconds)"
    default 61440
    help
        Determines how frequently a Sleepy End Device wakes up to check with its parent device for any pending messages.
        Adjusting this interval affects the device's responsiveness to incoming messages and its power consumption.
        It's recommended to set this period shorter than one-third of the End Device Timeout period to prevent unexpected device aging.

config SENSOR_INIT_BASIC_MANUF_NAME
    string "Manufacturer name of the Zigbee device (maximum 32 characters)"
    default "SHAM_TBZ"
    help
        Specifies the manufacturer name for the device's basic cluster. This information is used in device identification and should not exceed 32 characters.

config SENSOR_INIT_BASIC_MODEL_ID
    string "Model identifier assigned by the manufacturer (maximum 32 characters)"
    default "Environmental Sensor 0.0.1"
    help
        Defines the model identifier for the device's basic cluster. This helps in distinguishing different models and should be concise, not exceeding 32 characters.

endmenu

source "Kconfig.zephyr"
```

## prj.conf
```kconfig
#
# Copyright (c) 2024 Tareq Mhisen
#
# SPDX-License-Identifier: Apache-2.0
#

#
# LOGGING
#
CONFIG_LOG=y
# Disabled to save power, enable it only for debugging
CONFIG_SERIAL=y

#
# ENVIRONMENTAL SENSORS
#
CONFIG_I2C=y
CONFIG_SENSOR=y
```

## src/main.c
```c
/*
 * Copyright (c) 2024 Tareq Mhisen
 *
 * SPDX-License-Identifier: Apache-2.0
 */

#include <zephyr/logging/log.h>

#include "humidity_temperature_svc.h"

LOG_MODULE_REGISTER(main, LOG_LEVEL_INF);

int main(void)
{
	int ret;

	LOG_INF("Starting up .. .. ..");

	ret = humidity_temperature_svc_init();
	if (ret != 0) {
		LOG_ERR("Failed to initialize humidity and temperature service!");
	}

	return 0;
}
```

## src/events_svc.c
```c
/*
 * Copyright (c) 2024 Tareq Mhisen
 *
 * SPDX-License-Identifier: Apache-2.0
 */

#include <zephyr/kernel.h>
#include <zephyr/logging/log.h>

#include "events_svc.h"

LOG_MODULE_REGISTER(events_svc);

K_MSGQ_DEFINE(event_msq, sizeof(struct event), EVENT_QUEUE_SIZE, 4);

char *events_svc_type_to_text(enum event_type type)
{
	switch (type) {
	case EVENT_NETWORK_CONNECTED:
		return "EVENT_NETWORK_CONNECTED";
	case EVENT_NETWORK_NOT_CONNECTED:
		return "EVENT_NETWORK_NOT_CONNECTED";
	case EVENT_ZIGBEE_DATA_WIPED:
		return "EVENT_ZIGBEE_DATA_WIPED";
	default:
		return "UNKNOWN";
	}
}

int events_svc_send_event(struct event *evt)
{
	return k_msgq_put(&event_msq, evt, K_NO_WAIT);
}

int events_svc_get_event(struct event *evt)
{
	return k_msgq_get(&event_msq, evt, K_FOREVER);
}
```

## src/events_svc.h
```c
/*
 * Copyright (c) 2024 Tareq Mhisen
 *
 * SPDX-License-Identifier: Apache-2.0
 */

#ifndef APP_EVENT_MANAGER_H_
#define APP_EVENT_MANAGER_H_

#define EVENT_QUEUE_SIZE 10

enum event_type {
	EVENT_NETWORK_CONNECTED,
	EVENT_NETWORK_NOT_CONNECTED,
	EVENT_ZIGBEE_DATA_WIPED,
};

struct event {
	enum event_type type;
};

/**
 * @brief Get the text representation of an event
 *
 * @param type event type enum
 * @return char* NULL if error
 */
char *events_svc_type_to_text(enum event_type type);

/**
 * @brief Pushes an event to the message queue
 *
 * @param evt pointer to the event to be sent.
 * @return int
 */
int events_svc_send_event(struct event *evt);

/**
 * @brief Gets an event from the message queue
 *
 * @param evt pointer to the event to be received.
 * @return int
 */
int events_svc_get_event(struct event *evt);

#endif /* APP_EVENT_MANAGER_H_ */
```

## src/humidity_temperature_svc.c
```c
/*
 * Copyright (c) 2024 Tareq Mhisen
 *
 * SPDX-License-Identifier: Apache-2.0
 */

#include <zephyr/device.h>
#include <zephyr/kernel.h>

#include "zb_environmental_sensor.h"

#include "humidity_temperature_svc.h"

#include <zephyr/logging/log.h>

LOG_MODULE_REGISTER(humidity_temperature_svc, LOG_LEVEL_DBG);

static const struct device *const rh_temp_dev = DEVICE_DT_GET_ONE(sensirion_sht4x);

struct humidity_temperature_data {
	struct sensor_value humidity;
	struct sensor_value temperature;
};

static struct humidity_temperature_data data;

int humidity_temperature_svc_trigger_measurement(void)
{
	int ret;

	ret = sensor_sample_fetch(rh_temp_dev);
	if (ret != 0) {
		return ret;
	}

	return 0;
}

float humidity_temperature_svc_get_temperature(void)
{
	int ret = sensor_channel_get(rh_temp_dev, SENSOR_CHAN_AMBIENT_TEMP, &data.temperature);
	if (ret) {
		LOG_ERR("Failed to get sensor channel: %d", ret);
		return ret;
	}

	LOG_DBG("Temperature: %3d.%06d [°C]", data.temperature.val1, data.temperature.val2);
	return sensor_value_to_float(&data.temperature);
}

float humidity_temperature_svc_get_humidity(void)
{
	int ret = sensor_channel_get(rh_temp_dev, SENSOR_CHAN_HUMIDITY, &data.humidity);
	if (ret) {
		LOG_ERR("Failed to get sensor channel: %d", ret);
		return ret;
	}

	LOG_DBG("Humidity: %3d.%06d [%%]", data.humidity.val1, data.humidity.val2);
	return sensor_value_to_float(&data.humidity);
}

int humidity_temperature_svc_init(void)
{
	if (!device_is_ready(rh_temp_dev)) {
		LOG_ERR("Failed to initialize humidity and temperature sensor!");
		return -ENODEV;
	}

	LOG_DBG("Humidity and temperature sensor initialized successfully");
	return 0;
}
```

## src/humidity_temperature_svc.h
```c
/*
 * Copyright (c) 2024 Tareq Mhisen
 *
 * SPDX-License-Identifier: Apache-2.0
 */

#ifndef APP_ENVIRONMENTAL_SENSORS_H_
#define APP_ENVIRONMENTAL_SENSORS_H_

#include <zephyr/drivers/sensor.h>

/* Measurements ranges for SHT40 sensor */
#define SENSOR_TEMP_CELSIUS_MIN           (-40)
#define SENSOR_TEMP_CELSIUS_MAX           (125)
#define SENSOR_TEMP_CELSIUS_TOLERANCE     (0.2)
#define SENSOR_HUMIDITY_PERCENT_MIN       (0)
#define SENSOR_HUMIDITY_PERCENT_MAX       (100)
#define SENSOR_HUMIDITY_PERCENT_TOLERANCE (1.8)

/**
 * @brief Triggers a new measurement for humidity and temperature.
 *
 * @return 0 on success, or a negative error code if the measurement fails.
 */
int humidity_temperature_svc_trigger_measurement(void);

/**
 * @brief Updates the Zigbee attributes for temperature and humidity.
 *
 * This function reads the temperature and humidity values from the sensor,
 * converts them to the Zigbee ZCL attribute format, and updates the
 * corresponding ZCL attributes for the environmental sensor.
 *
 * @return 0 on success, or a negative error code if an error occurs.
 */
int humidity_temperature_svc_update_zb_attributes(void);

/**
 * @brief Initialize the humidity and temperature sensor.
 *
 * @return 0 on success, or -ENODEV on failure
 */
int humidity_temperature_svc_init(void);

#endif
```

## src/zb_environmental_sensor.h
```c
/*
 * Copyright (c) 2022 Nordic Semiconductor ASA
 * Copyright (c) 2024 Tareq Mhisen
 *
 * SPDX-License-Identifier: LicenseRef-Nordic-5-Clause
 * SPDX-License-Identifier: Apache-2.0
 */

#ifndef APP_ENVIRONMENTAL_SENSOR_H
#define APP_ENVIRONMENTAL_SENSOR_H

#include <zcl/zb_zcl_temp_measurement_addons.h>
#include <zcl/zb_zcl_basic_addons.h>

/* Zigbee Cluster Library 4.4.2.2.1.1: MeasuredValue = 100x temperature in degrees Celsius */
#define ZCL_TEMPERATURE_MEASUREMENT_MEASURED_VALUE_MULTIPLIER 100
/* Zigbee Cluster Library 4.7.2.1.1: MeasuredValue = 100x water content in % */
#define ZCL_HUMIDITY_MEASUREMENT_MEASURED_VALUE_MULTIPLIER    100

/* Measurements ranges scaled for attribute values */
#define ENVIRONMENTAL_SENSOR_ATTR_TEMP_MIN                                                         \
	(SENSOR_TEMP_CELSIUS_MIN * ZCL_TEMPERATURE_MEASUREMENT_MEASURED_VALUE_MULTIPLIER)
#define ENVIRONMENTAL_SENSOR_ATTR_TEMP_MAX                                                         \
	(SENSOR_TEMP_CELSIUS_MAX * ZCL_TEMPERATURE_MEASUREMENT_MEASURED_VALUE_MULTIPLIER)
#define ENVIRONMENTAL_SENSOR_ATTR_TEMP_TOLERANCE                                                   \
	(SENSOR_TEMP_CELSIUS_TOLERANCE * ZCL_TEMPERATURE_MEASUREMENT_MEASURED_VALUE_MULTIPLIER)

#define ENVIRONMENTAL_SENSOR_ATTR_HUMIDITY_MIN                                                     \
	(SENSOR_HUMIDITY_PERCENT_MIN * ZCL_HUMIDITY_MEASUREMENT_MEASURED_VALUE_MULTIPLIER)
#define ENVIRONMENTAL_SENSOR_ATTR_HUMIDITY_MAX                                                     \
	(SENSOR_HUMIDITY_PERCENT_MAX * ZCL_HUMIDITY_MEASUREMENT_MEASURED_VALUE_MULTIPLIER)

/* Number chosen for the single endpoint provided by weather station */
#define ENVIRONMENTAL_SENSOR_ENDPOINT_NB 42

/* Temperature sensor device version */
#define ZB_HA_DEVICE_VER_TEMPERATURE_SENSOR       0
/* Basic, temperature, humidity */
#define ZB_HA_ENVIRONMENTAL_SENSOR_IN_CLUSTER_NUM 3

#define ZB_HA_ENVIRONMENTAL_SENSOR_OUT_CLUSTER_NUM 0

/* Temperature, humidity */
#define ZB_HA_ENVIRONMENTAL_SENSOR_REPORT_ATTR_COUNT 2

/** @brief Declare cluster list for environmental sensor device
    @param cluster_list_name - cluster list variable name
    @param basic_attr_list - attribute list for Basic cluster
    @param temperature_measurement_attr_list - attribute list for temperature measurement cluster
    @param humidity_measurement_attr_list - attribute list for humidity measurement cluster
 */
#define ZB_HA_DECLARE_ENVIRONMENTAL_SENSOR_CLUSTER_LIST(cluster_list_name, basic_attr_list,        \
							temperature_measurement_attr_list,         \
							humidity_measurement_attr_list)            \
	zb_zcl_cluster_desc_t cluster_list_name[] = {                                              \
		ZB_ZCL_CLUSTER_DESC(ZB_ZCL_CLUSTER_ID_BASIC,                                       \
				    ZB_ZCL_ARRAY_SIZE(basic_attr_list, zb_zcl_attr_t),             \
				    (basic_attr_list), ZB_ZCL_CLUSTER_SERVER_ROLE,                 \
				    ZB_ZCL_MANUF_CODE_INVALID),                                    \
		ZB_ZCL_CLUSTER_DESC(                                                               \
			ZB_ZCL_CLUSTER_ID_TEMP_MEASUREMENT,                                        \
			ZB_ZCL_ARRAY_SIZE(temperature_measurement_attr_list, zb_zcl_attr_t),       \
			(temperature_measurement_attr_list), ZB_ZCL_CLUSTER_SERVER_ROLE,           \
			ZB_ZCL_MANUF_CODE_INVALID),                                                \
		ZB_ZCL_CLUSTER_DESC(                                                               \
			ZB_ZCL_CLUSTER_ID_REL_HUMIDITY_MEASUREMENT,                                \
			ZB_ZCL_ARRAY_SIZE(humidity_measurement_attr_list, zb_zcl_attr_t),          \
			(humidity_measurement_attr_list), ZB_ZCL_CLUSTER_SERVER_ROLE,              \
			ZB_ZCL_MANUF_CODE_INVALID),                                                \
	}

#define ZB_ZCL_DECLARE_ENVIRONMENTAL_SENSOR_DESC(ep_name, ep_id, in_clust_num, out_clust_num)      \
	ZB_DECLARE_SIMPLE_DESC(in_clust_num, out_clust_num);                                       \
	ZB_AF_SIMPLE_DESC_TYPE(in_clust_num, out_clust_num)                                        \
	simple_desc_##ep_name = {ep_id,                                                            \
				 ZB_AF_HA_PROFILE_ID,                                              \
				 ZB_HA_TEMPERATURE_SENSOR_DEVICE_ID,                               \
				 ZB_HA_DEVICE_VER_TEMPERATURE_SENSOR,                              \
				 0,                                                                \
				 in_clust_num,                                                     \
				 out_clust_num,                                                    \
				 {                                                                 \
					 ZB_ZCL_CLUSTER_ID_BASIC,                                  \
					 ZB_ZCL_CLUSTER_ID_TEMP_MEASUREMENT,                       \
					 ZB_ZCL_CLUSTER_ID_REL_HUMIDITY_MEASUREMENT,               \
				 }}

#define ZB_HA_DECLARE_ENVIRONMENTAL_SENSOR_EP(ep_name, ep_id, cluster_list)                        \
	ZB_ZCL_DECLARE_ENVIRONMENTAL_SENSOR_DESC(ep_name, ep_id,                                   \
						 ZB_HA_ENVIRONMENTAL_SENSOR_IN_CLUSTER_NUM,        \
						 ZB_HA_ENVIRONMENTAL_SENSOR_OUT_CLUSTER_NUM);      \
	ZBOSS_DEVICE_DECLARE_REPORTING_CTX(reporting_info##ep_name,                                \
					   ZB_HA_ENVIRONMENTAL_SENSOR_REPORT_ATTR_COUNT);          \
	ZB_AF_DECLARE_ENDPOINT_DESC(                                                               \
		ep_name, ep_id, ZB_AF_HA_PROFILE_ID, 0, NULL,                                      \
		ZB_ZCL_ARRAY_SIZE(cluster_list, zb_zcl_cluster_desc_t), cluster_list,              \
		(zb_af_simple_desc_1_1_t *)&simple_desc_##ep_name,                                 \
		ZB_HA_ENVIRONMENTAL_SENSOR_REPORT_ATTR_COUNT, reporting_info##ep_name, 0, NULL)

/**@brief Temperature Measurement cluster attributes according to ZCL Spec 4.7.2.2.1. */
struct zb_zcl_humidity_measurement_attrs_t {
	zb_uint16_t measure_value;
	zb_uint16_t min_measure_value;
	zb_uint16_t max_measure_value;
};

struct zb_device_ctx {
	zb_zcl_basic_attrs_ext_t basic_attr;
	zb_zcl_temp_measurement_attrs_t temp_attrs;
	struct zb_zcl_humidity_measurement_attrs_t humidity_attrs;
};

#endif /* APP_ENVIRONMENTAL_SENSOR_H */
```

## src/zigbee_svc.c
```c
/*
 * Copyright (c) 2024 Tareq Mhisen
 *
 * SPDX-License-Identifier: Apache-2.0
 */

#include <zephyr/kernel.h>
#include <ram_pwrdn.h>

#include <zboss_api.h>
#include <zboss_api_addons.h>
#include <zb_nrf_platform.h>
#include <zigbee/zigbee_app_utils.h>
#include <zigbee/zigbee_error_handler.h>

#include "events_svc.h"
#include "humidity_temperature_svc.h"
#include "user_interface.h"
#include "zigbee_svc.h"

#include <zephyr/logging/log.h>

LOG_MODULE_REGISTER(zigbee_svc, LOG_LEVEL_DBG);

#define KEEP_ALIVE_PERIOD_MSEC (1000 * CONFIG_KEEP_ALIVE_PERIOD_SECONDS)
#define LONG_POLL_PERIOD_MSEC  (1000 * CONFIG_LONG_POLL_PERIOD_SECONDS)
#define IEEE_ADDR_BUF_SIZE     17

/* Stores all cluster-related attributes */
static struct zb_device_ctx dev_ctx;
static bool zigbee_data_wiped;

/* Declare attribute list for Basic cluster */
ZB_ZCL_DECLARE_BASIC_ATTRIB_LIST_EXT(basic_attr_list, &dev_ctx.basic_attr.zcl_version, NULL, NULL,
				     NULL, dev_ctx.basic_attr.mf_name, dev_ctx.basic_attr.model_id,
				     dev_ctx.basic_attr.date_code, &dev_ctx.basic_attr.power_source,
				     NULL, NULL, NULL);

/* Declare attribute list for temperature cluster */
ZB_ZCL_DECLARE_TEMP_MEASUREMENT_ATTRIB_LIST(temperature_measurement_attr_list,
					    &dev_ctx.temp_attrs.measure_value,
					    &dev_ctx.temp_attrs.min_measure_value,
					    &dev_ctx.temp_attrs.max_measure_value,
					    &dev_ctx.temp_attrs.tolerance);

/* Declare attribute list for humidity cluster */
ZB_ZCL_DECLARE_REL_HUMIDITY_MEASUREMENT_ATTRIB_LIST(humidity_measurement_attr_list,
						    &dev_ctx.humidity_attrs.measure_value,
						    &dev_ctx.humidity_attrs.min_measure_value,
						    &dev_ctx.humidity_attrs.max_measure_value);

/* Clusters setup */
ZB_HA_DECLARE_ENVIRONMENTAL_SENSOR_CLUSTER_LIST(environmental_sensor_cluster_list, basic_attr_list,
						temperature_measurement_attr_list,
						humidity_measurement_attr_list);

/* Endpoint setup (single) */
ZB_HA_DECLARE_ENVIRONMENTAL_SENSOR_EP(environmental_sensor_ep, ENVIRONMENTAL_SENSOR_ENDPOINT_NB,
				      environmental_sensor_cluster_list);

/* Device context */
ZBOSS_DECLARE_DEVICE_CTX_1_EP(environmental_sensor_ctx, environmental_sensor_ep);

void zigbee_svc_clusters_init(void)
{
	/* Basic cluster attributes */
	dev_ctx.basic_attr.zcl_version = ZB_ZCL_VERSION;
	dev_ctx.basic_attr.power_source = ZB_ZCL_BASIC_POWER_SOURCE_BATTERY;

	/* Use ZB_ZCL_SET_STRING_VAL to set strings, because the first byte
	 * should contain string length without trailing zero.
	 *
	 * For example "test" string will be encoded as:
	 *   [(0x4), 't', 'e', 's', 't']
	 */
	ZB_ZCL_SET_STRING_VAL(dev_ctx.basic_attr.mf_name, CONFIG_SENSOR_INIT_BASIC_MANUF_NAME,
			      ZB_ZCL_STRING_CONST_SIZE(CONFIG_SENSOR_INIT_BASIC_MANUF_NAME));

	ZB_ZCL_SET_STRING_VAL(dev_ctx.basic_attr.model_id, CONFIG_SENSOR_INIT_BASIC_MODEL_ID,
			      ZB_ZCL_STRING_CONST_SIZE(CONFIG_SENSOR_INIT_BASIC_MODEL_ID));

	/* Temperature */
	dev_ctx.temp_attrs.measure_value = ZB_ZCL_ATTR_TEMP_MEASUREMENT_VALUE_UNKNOWN;
	dev_ctx.temp_attrs.min_measure_value = ENVIRONMENTAL_SENSOR_ATTR_TEMP_MIN;
	dev_ctx.temp_attrs.max_measure_value = ENVIRONMENTAL_SENSOR_ATTR_TEMP_MAX;
	dev_ctx.temp_attrs.tolerance = ENVIRONMENTAL_SENSOR_ATTR_TEMP_TOLERANCE;

	/* Humidity */
	dev_ctx.humidity_attrs.measure_value = ZB_ZCL_ATTR_REL_HUMIDITY_MEASUREMENT_VALUE_UNKNOWN;
	dev_ctx.humidity_attrs.min_measure_value = ENVIRONMENTAL_SENSOR_ATTR_HUMIDITY_MIN;
	dev_ctx.humidity_attrs.max_measure_value = ENVIRONMENTAL_SENSOR_ATTR_HUMIDITY_MAX;
}

static void zigbee_svc_update_temperature_attribute(zb_bufid_t bufid, zb_uint16_t temperature)
{
	ZVUNUSED(bufid);
	/* Convert measured value to attribute value, as specified in ZCL */
	zb_int16_t temperature_attribute = (zb_int16_t)temperature;
	zb_zcl_status_t status;

	/* Set ZCL attribute */
	status = zb_zcl_set_attr_val(ENVIRONMENTAL_SENSOR_ENDPOINT_NB,
				     ZB_ZCL_CLUSTER_ID_TEMP_MEASUREMENT, ZB_ZCL_CLUSTER_SERVER_ROLE,
				     ZB_ZCL_ATTR_TEMP_MEASUREMENT_VALUE_ID,
				     (zb_uint8_t *)&temperature_attribute, ZB_FALSE);
	if (status != RET_OK) {
		LOG_ERR("Failed to update ZCL temperature attribute: %d", status);
	}
}

static void zigbee_svc_update_humidity_attribute(zb_bufid_t bufid, zb_uint16_t humidity)
{
	ZVUNUSED(bufid);
	zb_uint16_t humidity_attribute = humidity;
	zb_zcl_status_t status;

	/* Set ZCL attribute */
	status = zb_zcl_set_attr_val(
		ENVIRONMENTAL_SENSOR_ENDPOINT_NB, ZB_ZCL_CLUSTER_ID_REL_HUMIDITY_MEASUREMENT,
		ZB_ZCL_CLUSTER_SERVER_ROLE, ZB_ZCL_ATTR_REL_HUMIDITY_MEASUREMENT_VALUE_ID,
		(zb_uint8_t *)&humidity_attribute, ZB_FALSE);
	if (status != RET_OK) {
		LOG_ERR("Failed to update ZCL humidity attribute: %d", status);
	}
}

static void log_reporting_info(zb_uint8_t endpoint, zb_uint16_t cluster_id, zb_uint16_t attr_id)
{
	zb_zcl_reporting_info_t *rep_info;

	rep_info = zb_zcl_find_reporting_info(endpoint, cluster_id, ZB_ZCL_CLUSTER_SERVER_ROLE,
					      attr_id);
	if (rep_info) {
		LOG_INF("Reporting info for Endpoint: %d, Cluster: 0x%04X, Attribute: 0x%04X",
			endpoint, cluster_id, attr_id);
		LOG_INF("DEF Min Interval: %d, DEF Max Interval: %d",
			rep_info->u.send_info.def_min_interval,
			rep_info->u.send_info.def_max_interval);
		LOG_INF("Min Interval: %d, Max Interval: %d", rep_info->u.send_info.min_interval,
			rep_info->u.send_info.max_interval);
		LOG_INF("Reportable Change: %d", rep_info->u.send_info.delta.s16);
	} else {
		LOG_WRN("No reporting info found for Endpoint: %d, Cluster: 0x%04X, Attribute: "
			"0x%04X",
			endpoint, cluster_id, attr_id);
	}
}

static void start_joining(zb_bufid_t bufid)
{
	ZVUNUSED(bufid);

	if (!ZB_JOINED()) {
		LOG_WRN("Device not in a network -> Restart joining procedure");
		bdb_start_top_level_commissioning(ZB_BDB_NETWORK_STEERING);
	} else {
		LOG_INF("Device is already in a network");
		ui_flash_status_led(250);
	}
}

int zigbee_svc_schedule_fn(enum zigbee_function fn_id, uint16_t user_param)
{
	zb_ret_t ret = 0;

	switch (fn_id) {

	case ZIGBEE_START_JOINING:
		ARG_UNUSED(user_param);
		ret = ZB_SCHEDULE_APP_CALLBACK(start_joining, 0);
		if (ret) {
			LOG_ERR("Failed to schedule start_joining function!: %d", ret);
		}
		break;

	case ZIGBEE_WIPE_DATA:
		ARG_UNUSED(user_param);
		LOG_WRN("Performing factory reset . . .");
		ret = ZB_SCHEDULE_APP_CALLBACK(zb_bdb_reset_via_local_action, 0);
		if (ret) {
			LOG_ERR("Failed to schedule zb_bdb_reset_via_local_action function!: %d",
				ret);
		}
		zigbee_erase_persistent_storage(true);
		zigbee_data_wiped = true;
		break;

	case ZIGBEE_UPDATE_TEMPERATURE_ATTRIBUTE:
		ret = ZB_SCHEDULE_APP_CALLBACK2(zigbee_svc_update_temperature_attribute, 0,
						user_param);
		if (ret) {
			LOG_ERR("Failed to schedule zigbee_svc_update_zb_attributes function!: %d",
				ret);
		}
		break;

	case ZIGBEE_UPDATE_HUMIDITY_ATTRIBUTE:
		ret = ZB_SCHEDULE_APP_CALLBACK2(zigbee_svc_update_humidity_attribute, 0,
						user_param);
		if (ret) {
			LOG_ERR("Failed to schedule zigbee_svc_update_zb_attributes function!: %d",
				ret);
		}
		break;

	default:
		break;
	}

	return ret;
}

void zboss_signal_handler(zb_bufid_t bufid)
{
	int ret;
	zb_zdo_app_signal_hdr_t *signal_header = NULL;
	zb_zdo_app_signal_type_t signal = zb_get_app_signal(bufid, &signal_header);
	zb_ret_t status = ZB_GET_APP_SIGNAL_STATUS(bufid);
	/* Flag indicating if a joining signal has been received since restart or leave with rejoin.
	 */
	static bool joining_signal_received = false;

	switch (signal) {
	case ZB_BDB_SIGNAL_DEVICE_FIRST_START:
		/* fall-through */
	case ZB_BDB_SIGNAL_DEVICE_REBOOT:
		/* fall-through */
	case ZB_BDB_SIGNAL_STEERING:
		/* Call default signal handler. */
		ZB_ERROR_CHECK(zigbee_default_signal_handler(bufid));

		if (ZB_JOINED()) {
			joining_signal_received = true;

			struct event evt = {.type = EVENT_NETWORK_CONNECTED};
			ret = events_svc_send_event(&evt);
			if (ret != 0) {
				LOG_ERR("Unable to send network connected event. ret %d", ret);
			}

			log_reporting_info(ENVIRONMENTAL_SENSOR_ENDPOINT_NB,
					   ZB_ZCL_CLUSTER_ID_TEMP_MEASUREMENT,
					   ZB_ZCL_ATTR_TEMP_MEASUREMENT_VALUE_ID);
			log_reporting_info(ENVIRONMENTAL_SENSOR_ENDPOINT_NB,
					   ZB_ZCL_CLUSTER_ID_REL_HUMIDITY_MEASUREMENT,
					   ZB_ZCL_ATTR_REL_HUMIDITY_MEASUREMENT_VALUE_ID);
		} else {
			LOG_WRN("Device is not connected to any network!");

			struct event evt = {.type = EVENT_NETWORK_NOT_CONNECTED};
			ret = events_svc_send_event(&evt);
			if (ret != 0) {
				LOG_ERR("Unable to send network disconnected event. ret %d", ret);
			}
		}
		break;

	case ZB_ZDO_SIGNAL_LEAVE:
		if (status == RET_OK) {
			zb_zdo_signal_leave_params_t *leave_params = ZB_ZDO_SIGNAL_GET_PARAMS(
				signal_header, zb_zdo_signal_leave_params_t);
			LOG_INF("Network left (leave type: %d)", leave_params->leave_type);

			/* Set joining_signal_received to false to detect a broken rejoin procedure.
			 */
			if (leave_params->leave_type == ZB_NWK_LEAVE_TYPE_REJOIN) {
				joining_signal_received = false;
			}

			struct event evt;
			evt.type = EVENT_NETWORK_NOT_CONNECTED;

			if (zigbee_data_wiped) {
				evt.type = EVENT_ZIGBEE_DATA_WIPED;
			}

			ret = events_svc_send_event(&evt);
			if (ret != 0) {
				LOG_ERR("Unable to send network disconnected event. ret %d", ret);
			}
		}
		break;

	case ZB_NLME_STATUS_INDICATION: {
		zb_zdo_signal_nlme_status_indication_params_t *nlme_status_ind =
			ZB_ZDO_SIGNAL_GET_PARAMS(signal_header,
						 zb_zdo_signal_nlme_status_indication_params_t);
		if (nlme_status_ind->nlme_status.status ==
		    ZB_NWK_COMMAND_STATUS_PARENT_LINK_FAILURE) {
			LOG_WRN("Parent link failure detected.");

			/* Check for a broken rejoin procedure and restart the device to recover. */
			if (!joining_signal_received) {
				LOG_ERR("Rejoin procedure failed. Resetting device.");
				ret = zigbee_svc_schedule_fn(ZIGBEE_WIPE_DATA, 0);
				if (ret != 0) {
					LOG_ERR("Failed to wipe zigbee data!");
				}
			} else {
				ret = ZB_SCHEDULE_APP_CALLBACK(start_joining, 0);
				if (ret) {
					LOG_ERR("Failed to schedule start_joining function!: %d",
						ret);
				}
			}
		}
	} break;

	default:
		/* Let default signal handler process the signal */
		ZB_ERROR_CHECK(zigbee_default_signal_handler(bufid));
		break;
	}

	/*
	 * All callbacks should either reuse or free passed buffers.
	 * If bufid == 0, the buffer is invalid (not passed).
	 */
	if (bufid) {
		zb_buf_free(bufid);
	}
}

void zigbee_svc_start(void)
{
	/* Enable Sleepy End Device behavior */
	zb_set_rx_on_when_idle(ZB_FALSE);
	if (IS_ENABLED(CONFIG_RAM_POWER_DOWN_LIBRARY)) {
		power_down_unused_ram();
	}

	zb_set_ed_timeout(CONFIG_NWK_ED_DEVICE_TIMEOUT_INDEX);
	zb_set_keepalive_timeout(ZB_MILLISECONDS_TO_BEACON_INTERVAL(KEEP_ALIVE_PERIOD_MSEC));

	/* Start Zigbee stack */
	zigbee_enable();

	LOG_INF("Zigbee environmental sensor started");
}

void zigbee_svc_init(void)
{
	/* Register device context (endpoint) */
	ZB_AF_REGISTER_DEVICE_CTX(&environmental_sensor_ctx);

	/* Init Basic and Identify and measurements-related attributes */
	zigbee_svc_clusters_init();
	zigbee_svc_update_humidity_attribute(0, 0);
	zigbee_svc_update_temperature_attribute(0, 0);
}
```

## src/zigbee_svc.h
```c
/*
 * Copyright (c) 2024 Tareq Mhisen
 *
 * SPDX-License-Identifier: Apache-2.0
 */

#ifndef APP_ZIGBEE_SVC_H
#define APP_ZIGBEE_SVC_H

#include "zb_environmental_sensor.h"

enum zigbee_function {
	ZIGBEE_START_JOINING,
	ZIGBEE_WIPE_DATA,
	ZIGBEE_UPDATE_TEMPERATURE_ATTRIBUTE,
	ZIGBEE_UPDATE_HUMIDITY_ATTRIBUTE,
};

/**
 * @brief Schedules a Zigbee function for execution.
 *
 * @param[in] fn_id The Zigbee function to execute:
 *                  - ZIGBEE_START_JOINING: Start Zigbee network joining.
 *                  - ZIGBEE_WIPE_DATA: Factory reset and wipe Zigbee data.
 *                  - ZIGBEE_UPDATE_TEMPERATURE_ATTRIBUTE: Update temperature attribute.
 *                  - ZIGBEE_UPDATE_HUMIDITY_ATTRIBUTE: Update humidity attribute.
 * @param[in] user_param Data associated with the function (scaled sensor values for updates).
 *
 * @return 0 on success, negative error code on failure.
 *
 * @note The function is executed asynchronously via the Zigbee stack.
 */
int zigbee_svc_schedule_fn(enum zigbee_function fn_id, uint16_t user_param);

/**
 * @brief Starts the Zigbee service.
 *
 * @details Function configures the Zigbee device as a Sleepy End Device (SED),
 *          powers down unused RAM if configured, and enables the Zigbee stack.
 */
void zigbee_svc_start(void);

/**
 * @brief Initializes the Zigbee service.
 */
void zigbee_svc_init(void);

#endif /* APP_ZIGBEE_SVC_H */
```
